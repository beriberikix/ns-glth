## west.yml
```yaml
# Copyright (c) 2022-2023 Golioth, Inc.
# SPDX-License-Identifier: Apache-2.0

manifest:
  projects:
    - name: golioth
      path: modules/lib/golioth-firmware-sdk
      revision: v0.15.0
      url: https://github.com/golioth/golioth-firmware-sdk.git
      west-commands: scripts/west-commands.yml
      submodules: true
      import:
        file: west-zephyr.yml
        path-prefix: deps
        name-allowlist:
          - zephyr
          - mbedtls
          - mcuboot
          - zcbor

  self:
    path: app
```
